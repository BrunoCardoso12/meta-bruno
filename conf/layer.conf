## conf/layer.conf
```bitbake
BBPATH .= ":${LAYERDIR}"

BBFILES += "${LAYERDIR}/recipes-*/*/*.bb \
            ${LAYERDIR}/recipes-*/*/*.bbappend"

BBFILE_COLLECTIONS += "bruno"
BBFILE_PATTERN_bruno = "^${LAYERDIR}/"
BBFILE_PRIORITY_bruno = "6"

LAYERSERIES_COMPAT_bruno = "wrynose"
```
